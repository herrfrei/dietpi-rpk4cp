/dts-v1/;
/plugin/;

/ {
    compatible = "rockchip,rk3399";
    
    fragment@0 {
        target = <&i2c7>;
        __overlay__ {
            #address-cells = <1>;
            #size-cells = <0>;
            rtc: rtc@68 {
                compatible = "maxim,ds3231";
                reg = <0x68>;
                status = "okay";
            };
        };
    };
};